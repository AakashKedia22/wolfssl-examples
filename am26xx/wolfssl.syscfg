/**
 * @cliArgs --device "AM263Px" --package "ZCZ_S" --part "AM263P4" --context "hsm0-0" --product "TIFS@07.03.01" --product "MCU_PLUS_SDK@07.03.01"
 * @versions {"tool":"1.20.0+3587"}
 */

/**
 * Import the modules used in this configuration.
 */
const dthe           = scripting.addModule("/drivers/dthe/dthe", {}, false);
const dthe1          = dthe.addInstance();
const mpu_firewall   = scripting.addModule("/drivers/mpu_firewall/mpu_firewall", {}, false);
const mpu_firewall1  = mpu_firewall.addInstance();
const mpu_firewall2  = mpu_firewall.addInstance();
const mpu_firewall3  = mpu_firewall.addInstance();
const mpu_firewall4  = mpu_firewall.addInstance();
const mpu_firewall5  = mpu_firewall.addInstance();
const mpu_firewall6  = mpu_firewall.addInstance();
const mpu_firewall7  = mpu_firewall.addInstance();
const mpu_firewall8  = mpu_firewall.addInstance();
const mpu_firewall9  = mpu_firewall.addInstance();
const mpu_firewall10 = mpu_firewall.addInstance();
const mpu_firewall11 = mpu_firewall.addInstance();
const mpu_firewall12 = mpu_firewall.addInstance();
const mpu_firewall13 = mpu_firewall.addInstance();
const mpu_firewall14 = mpu_firewall.addInstance();
const mpu_firewall15 = mpu_firewall.addInstance();
const mpu_firewall16 = mpu_firewall.addInstance();
const mpu_firewall17 = mpu_firewall.addInstance();
const mpu_firewall18 = mpu_firewall.addInstance();
const mpu_firewall19 = mpu_firewall.addInstance();
const mpu_firewall20 = mpu_firewall.addInstance();
const mpu_firewall21 = mpu_firewall.addInstance();
const mpu_firewall22 = mpu_firewall.addInstance();
const mpu_firewall23 = mpu_firewall.addInstance();
const clock          = scripting.addModule("/kernel/dpl/clock");
const debug_log      = scripting.addModule("/kernel/dpl/debug_log");
const dpl_cfg        = scripting.addModule("/kernel/dpl/dpl_cfg");
const mpu_armv7      = scripting.addModule("/kernel/dpl/mpu_armv7", {}, false);
const mpu_armv71     = mpu_armv7.addInstance();
const mpu_armv72     = mpu_armv7.addInstance();
const mpu_armv73     = mpu_armv7.addInstance();
const hsmserver      = scripting.addModule("/modules/hsmserver/hsmserver", {}, false);
const hsmserver1     = hsmserver.addInstance();
const keyring        = scripting.addModule("/modules/keyring/keyring", {}, false);
const keyring1       = keyring.addInstance();

/**
 * Write custom configuration values to the imported modules.
 */
dthe1.$name = "CONFIG_DTHE0";
dthe1.enableDMA = true;

mpu_firewall1.$name                          = "CONFIG_MPU_FIREWALL0";
mpu_firewall1.mpu_region.create(1);
mpu_firewall1.mpu_region[0].$name            = "CONFIG_MPU_FIREWALL_REGION0";
mpu_firewall1.mpu_region[0].permissionConfig = ["PER0","PER1","PER2","PER3","PER4","PER5","PER6","PER7"];
mpu_firewall1.mpu_region[0].aidConfig        = ["AIDX","CPSW","ICSSM","M4FSS0_0","R5FSS0_0","R5FSS0_1","R5FSS1_0","R5FSS1_1"];
mpu_firewall1.mpu_region[0].allaidConfig     = true;
mpu_firewall1.mpu_region[0].allPermissions   = true;

mpu_firewall2.$name                          = "CONFIG_MPU_FIREWALL1";
mpu_firewall2.instance                       = "L2OCRAM_BANK1_SLV";
mpu_firewall2.mpu_region.create(1);
mpu_firewall2.mpu_region[0].$name            = "CONFIG_MPU_FIREWALL_REGION1";
mpu_firewall2.mpu_region[0].permissionConfig = ["PER0","PER1","PER2","PER3","PER4","PER5","PER6","PER7"];
mpu_firewall2.mpu_region[0].aidConfig        = ["AIDX","CPSW","ICSSM","M4FSS0_0","R5FSS0_0","R5FSS0_1","R5FSS1_0","R5FSS1_1"];
mpu_firewall2.mpu_region[0].allaidConfig     = true;
mpu_firewall2.mpu_region[0].allPermissions   = true;

mpu_firewall3.$name                        = "CONFIG_MPU_FIREWALL2";
mpu_firewall3.instance                     = "L2OCRAM_BANK2_SLV";
mpu_firewall3.mpu_region.create(1);
mpu_firewall3.mpu_region[0].$name          = "CONFIG_MPU_FIREWALL_REGION2";
mpu_firewall3.mpu_region[0].allaidConfig   = true;
mpu_firewall3.mpu_region[0].allPermissions = true;

mpu_firewall4.$name                        = "CONFIG_MPU_FIREWALL3";
mpu_firewall4.instance                     = "L2OCRAM_BANK3_SLV";
mpu_firewall4.mpu_region.create(1);
mpu_firewall4.mpu_region[0].$name          = "CONFIG_MPU_FIREWALL_REGION3";
mpu_firewall4.mpu_region[0].allaidConfig   = true;
mpu_firewall4.mpu_region[0].allPermissions = true;

mpu_firewall5.$name                          = "CONFIG_MPU_FIREWALL4";
mpu_firewall5.instance                       = "R5SS0_CORE0_AXIS_SLV";
mpu_firewall5.mpu_region.create(5);
mpu_firewall5.mpu_region[0].$name            = "CONFIG_MPU_FIREWALL_REGION4";
mpu_firewall5.mpu_region[0].permissionConfig = ["PER0","PER1","PER2","PER3","PER4","PER5","PER6","PER7"];
mpu_firewall5.mpu_region[0].allaidConfig     = true;
mpu_firewall5.mpu_region[0].allPermissions   = true;
mpu_firewall5.mpu_region[1].$name            = "CONFIG_MPU_FIREWALL_REGION9";
mpu_firewall5.mpu_region[1].startAddr        = 0x78100000;
mpu_firewall5.mpu_region[1].aidConfig        = ["AIDX","CPSW","ICSSM","M4FSS0_0","R5FSS0_0","R5FSS0_1","R5FSS1_0","R5FSS1_1"];
mpu_firewall5.mpu_region[1].allaidConfig     = true;
mpu_firewall5.mpu_region[1].allPermissions   = true;
mpu_firewall5.mpu_region[2].$name            = "CONFIG_MPU_FIREWALL_REGION10";
mpu_firewall5.mpu_region[2].startAddr        = 0x74000000;
mpu_firewall5.mpu_region[2].size             = 0x800000;
mpu_firewall5.mpu_region[2].allaidConfig     = true;
mpu_firewall5.mpu_region[2].allPermissions   = true;
mpu_firewall5.mpu_region[3].$name            = "CONFIG_MPU_FIREWALL_REGION20";
mpu_firewall5.mpu_region[3].startAddr        = 0x74800000;
mpu_firewall5.mpu_region[3].size             = 0x800000;
mpu_firewall5.mpu_region[3].allaidConfig     = true;
mpu_firewall5.mpu_region[3].allPermissions   = true;
mpu_firewall5.mpu_region[4].$name            = "CONFIG_MPU_FIREWALL_REGION51";
mpu_firewall5.mpu_region[4].startAddr        = 0x78060000;
mpu_firewall5.mpu_region[4].allaidConfig     = true;
mpu_firewall5.mpu_region[4].allPermissions   = true;
mpu_firewall5.mpu_region[4].size             = 0x400;

mpu_firewall6.$name                          = "CONFIG_MPU_FIREWALL5";
mpu_firewall6.instance                       = "R5SS0_CORE1_AXIS_SLV";
mpu_firewall6.mpu_region.create(5);
mpu_firewall6.mpu_region[0].$name            = "CONFIG_MPU_FIREWALL_REGION5";
mpu_firewall6.mpu_region[0].permissionConfig = ["PER0","PER1","PER2","PER3","PER4","PER5","PER6","PER7"];
mpu_firewall6.mpu_region[0].allaidConfig     = true;
mpu_firewall6.mpu_region[0].allPermissions   = true;
mpu_firewall6.mpu_region[1].$name            = "CONFIG_MPU_FIREWALL_REGION21";
mpu_firewall6.mpu_region[1].startAddr        = 0x78300000;
mpu_firewall6.mpu_region[1].allaidConfig     = true;
mpu_firewall6.mpu_region[1].allPermissions   = true;
mpu_firewall6.mpu_region[2].$name            = "CONFIG_MPU_FIREWALL_REGION22";
mpu_firewall6.mpu_region[2].startAddr        = 0x75000000;
mpu_firewall6.mpu_region[2].size             = 0x800000;
mpu_firewall6.mpu_region[2].allaidConfig     = true;
mpu_firewall6.mpu_region[2].allPermissions   = true;
mpu_firewall6.mpu_region[3].$name            = "CONFIG_MPU_FIREWALL_REGION23";
mpu_firewall6.mpu_region[3].startAddr        = 0x75800000;
mpu_firewall6.mpu_region[3].size             = 0x800000;
mpu_firewall6.mpu_region[3].allaidConfig     = true;
mpu_firewall6.mpu_region[3].allPermissions   = true;
mpu_firewall6.mpu_region[4].$name            = "CONFIG_MPU_FIREWALL_REGION52";
mpu_firewall6.mpu_region[4].startAddr        = 0x78260000;
mpu_firewall6.mpu_region[4].allaidConfig     = true;
mpu_firewall6.mpu_region[4].allPermissions   = true;
mpu_firewall6.mpu_region[4].size             = 0x400;

mpu_firewall7.$name                        = "CONFIG_MPU_FIREWALL6";
mpu_firewall7.instance                     = "R5SS1_CORE0_AXIS_SLV";
mpu_firewall7.mpu_region.create(5);
mpu_firewall7.mpu_region[0].$name          = "CONFIG_MPU_FIREWALL_REGION6";
mpu_firewall7.mpu_region[0].allaidConfig   = true;
mpu_firewall7.mpu_region[0].allPermissions = true;
mpu_firewall7.mpu_region[1].$name          = "CONFIG_MPU_FIREWALL_REGION24";
mpu_firewall7.mpu_region[1].startAddr      = 0x78500000;
mpu_firewall7.mpu_region[1].allPermissions = true;
mpu_firewall7.mpu_region[1].allaidConfig   = true;
mpu_firewall7.mpu_region[2].$name          = "CONFIG_MPU_FIREWALL_REGION25";
mpu_firewall7.mpu_region[2].startAddr      = 0x76000000;
mpu_firewall7.mpu_region[2].size           = 0x800000;
mpu_firewall7.mpu_region[2].allaidConfig   = true;
mpu_firewall7.mpu_region[2].allPermissions = true;
mpu_firewall7.mpu_region[3].$name          = "CONFIG_MPU_FIREWALL_REGION26";
mpu_firewall7.mpu_region[3].startAddr      = 0x76800000;
mpu_firewall7.mpu_region[3].size           = 0x800000;
mpu_firewall7.mpu_region[3].allaidConfig   = true;
mpu_firewall7.mpu_region[3].allPermissions = true;
mpu_firewall7.mpu_region[4].$name          = "CONFIG_MPU_FIREWALL_REGION53";
mpu_firewall7.mpu_region[4].startAddr      = 0x78460000;
mpu_firewall7.mpu_region[4].allaidConfig   = true;
mpu_firewall7.mpu_region[4].allPermissions = true;
mpu_firewall7.mpu_region[4].size           = 0x400;

mpu_firewall8.$name                        = "CONFIG_MPU_FIREWALL7";
mpu_firewall8.instance                     = "R5SS1_CORE1_AXIS_SLV";
mpu_firewall8.mpu_region.create(5);
mpu_firewall8.mpu_region[0].$name          = "CONFIG_MPU_FIREWALL_REGION7";
mpu_firewall8.mpu_region[0].allaidConfig   = true;
mpu_firewall8.mpu_region[0].allPermissions = true;
mpu_firewall8.mpu_region[1].$name          = "CONFIG_MPU_FIREWALL_REGION27";
mpu_firewall8.mpu_region[1].startAddr      = 0x78700000;
mpu_firewall8.mpu_region[1].allaidConfig   = true;
mpu_firewall8.mpu_region[1].allPermissions = true;
mpu_firewall8.mpu_region[2].$name          = "CONFIG_MPU_FIREWALL_REGION28";
mpu_firewall8.mpu_region[2].startAddr      = 0x77000000;
mpu_firewall8.mpu_region[2].size           = 0x800000;
mpu_firewall8.mpu_region[2].allaidConfig   = true;
mpu_firewall8.mpu_region[2].allPermissions = true;
mpu_firewall8.mpu_region[3].$name          = "CONFIG_MPU_FIREWALL_REGION29";
mpu_firewall8.mpu_region[3].startAddr      = 0x77800000;
mpu_firewall8.mpu_region[3].size           = 0x800000;
mpu_firewall8.mpu_region[3].allaidConfig   = true;
mpu_firewall8.mpu_region[3].allPermissions = true;
mpu_firewall8.mpu_region[4].$name          = "CONFIG_MPU_FIREWALL_REGION54";
mpu_firewall8.mpu_region[4].startAddr      = 0x78660000;
mpu_firewall8.mpu_region[4].allaidConfig   = true;
mpu_firewall8.mpu_region[4].allPermissions = true;
mpu_firewall8.mpu_region[4].size           = 0x400;

mpu_firewall9.$name                        = "CONFIG_MPU_FIREWALL8";
mpu_firewall9.instance                     = "MBOX_RAM_SLV";
mpu_firewall9.mpu_region.create(1);
mpu_firewall9.mpu_region[0].$name          = "CONFIG_MPU_FIREWALL_REGION8";
mpu_firewall9.mpu_region[0].allaidConfig   = true;
mpu_firewall9.mpu_region[0].allPermissions = true;

mpu_firewall10.$name                          = "CONFIG_MPU_FIREWALL10";
mpu_firewall10.instance                       = "HSM_SLV";
mpu_firewall10.mpu_region.create(7);
mpu_firewall10.mpu_region[0].$name            = "CONFIG_MPU_FIREWALL_REGION18";
mpu_firewall10.mpu_region[0].startAddr        = 0x44000400;
mpu_firewall10.mpu_region[0].size             = 0x400;
mpu_firewall10.mpu_region[0].aidConfig        = ["M4FSS0_0","R5FSS0_0","R5FSS0_1"];
mpu_firewall10.mpu_region[0].permissionConfig = ["PER0","PER1","PER3","PER4","PER6","PER7"];
mpu_firewall10.mpu_region[1].$name            = "CONFIG_MPU_FIREWALL_REGION19";
mpu_firewall10.mpu_region[1].startAddr        = 0x44000000;
mpu_firewall10.mpu_region[1].size             = 0x400;
mpu_firewall10.mpu_region[1].aidConfig        = ["R5FSS0_0","R5FSS0_1"];
mpu_firewall10.mpu_region[1].permissionConfig = ["PER0","PER3"];
mpu_firewall10.mpu_region[2].$name            = "CONFIG_MPU_FIREWALL_REGION49";
mpu_firewall10.mpu_region[2].startAddr        = 0x40020000;
mpu_firewall10.mpu_region[2].size             = 0x100000;
mpu_firewall10.mpu_region[2].permissionConfig = ["PER0","PER3"];
mpu_firewall10.mpu_region[3].$name            = "CONFIG_MPU_FIREWALL_REGION50";
mpu_firewall10.mpu_region[3].startAddr        = 0x40140000;
mpu_firewall10.mpu_region[3].size             = 0x100000;
mpu_firewall10.mpu_region[3].permissionConfig = ["PER0","PER3"];
mpu_firewall10.mpu_region[4].$name            = "CONFIG_MPU_FIREWALL_REGION65";
mpu_firewall10.mpu_region[4].startAddr        = 0x40260000;
mpu_firewall10.mpu_region[4].size             = 0x80400;
mpu_firewall10.mpu_region[4].permissionConfig = ["PER0","PER3"];
mpu_firewall10.mpu_region[5].$name            = "CONFIG_MPU_FIREWALL_REGION67";
mpu_firewall10.mpu_region[5].startAddr        = 0x40000000;
mpu_firewall10.mpu_region[5].aidConfig        = ["M4FSS0_0"];
mpu_firewall10.mpu_region[5].permissionConfig = ["PER0","PER1","PER2","PER3","PER4","PER5","PER6","PER7"];
mpu_firewall10.mpu_region[5].allPermissions   = true;
mpu_firewall10.mpu_region[6].$name            = "CONFIG_MPU_FIREWALL_REGION68";
mpu_firewall10.mpu_region[6].startAddr        = 0x20020000;
mpu_firewall10.mpu_region[6].aidConfig        = ["M4FSS0_0"];
mpu_firewall10.mpu_region[6].permissionConfig = ["PER0","PER1","PER2","PER3","PER4","PER5","PER6","PER7"];
mpu_firewall10.mpu_region[6].allPermissions   = true;
mpu_firewall10.mpu_region[6].size             = 0x40000;

mpu_firewall11.$name                        = "CONFIG_MPU_FIREWALL11";
mpu_firewall11.instance                     = "DTHE_SLV";
mpu_firewall11.mpu_region.create(8);
mpu_firewall11.mpu_region[0].$name          = "CONFIG_MPU_FIREWALL_REGION11";
mpu_firewall11.mpu_region[0].allPermissions = true;
mpu_firewall11.mpu_region[0].size           = 0x800;
mpu_firewall11.mpu_region[0].aidConfig      = ["M4FSS0_0"];
mpu_firewall11.mpu_region[1].$name          = "CONFIG_MPU_FIREWALL_REGION42";
mpu_firewall11.mpu_region[1].startAddr      = 0xCE010000;
mpu_firewall11.mpu_region[1].aidConfig      = ["M4FSS0_0"];
mpu_firewall11.mpu_region[1].allPermissions = true;
mpu_firewall11.mpu_region[1].size           = 0x8000;
mpu_firewall11.mpu_region[2].$name          = "CONFIG_MPU_FIREWALL_REGION43";
mpu_firewall11.mpu_region[2].startAddr      = 0xCE00A000;
mpu_firewall11.mpu_region[2].aidConfig      = ["M4FSS0_0"];
mpu_firewall11.mpu_region[2].allPermissions = true;
mpu_firewall11.mpu_region[2].size           = 0x1000;
mpu_firewall11.mpu_region[3].$name          = "CONFIG_MPU_FIREWALL_REGION44";
mpu_firewall11.mpu_region[3].startAddr      = 0xCE006000;
mpu_firewall11.mpu_region[3].aidConfig      = ["M4FSS0_0"];
mpu_firewall11.mpu_region[3].allPermissions = true;
mpu_firewall11.mpu_region[3].size           = 0x1000;
mpu_firewall11.mpu_region[4].$name          = "CONFIG_MPU_FIREWALL_REGION45";
mpu_firewall11.mpu_region[4].startAddr      = 0xCE004000;
mpu_firewall11.mpu_region[4].aidConfig      = ["M4FSS0_0"];
mpu_firewall11.mpu_region[4].allPermissions = true;
mpu_firewall11.mpu_region[4].size           = 0x1000;
mpu_firewall11.mpu_region[5].$name          = "CONFIG_MPU_FIREWALL_REGION46";
mpu_firewall11.mpu_region[5].startAddr      = 0xCE007000;
mpu_firewall11.mpu_region[5].size           = 0x1000;
mpu_firewall11.mpu_region[5].allaidConfig   = true;
mpu_firewall11.mpu_region[5].allPermissions = true;
mpu_firewall11.mpu_region[6].$name          = "CONFIG_MPU_FIREWALL_REGION47";
mpu_firewall11.mpu_region[6].startAddr      = 0xCE005000;
mpu_firewall11.mpu_region[6].size           = 0x1000;
mpu_firewall11.mpu_region[6].allaidConfig   = true;
mpu_firewall11.mpu_region[6].allPermissions = true;
mpu_firewall11.mpu_region[7].$name          = "CONFIG_MPU_FIREWALL_REGION48";
mpu_firewall11.mpu_region[7].startAddr      = 0xCE000800;
mpu_firewall11.mpu_region[7].size           = 0x800;
mpu_firewall11.mpu_region[7].allaidConfig   = true;
mpu_firewall11.mpu_region[7].allPermissions = true;

mpu_firewall12.$name                          = "CONFIG_MPU_FIREWALL12";
mpu_firewall12.instance                       = "SCRM2SCRP0_SLV";
mpu_firewall12.mpu_region.create(3);
mpu_firewall12.mpu_region[0].$name            = "CONFIG_MPU_FIREWALL_REGION30";
mpu_firewall12.mpu_region[0].startAddr        = 0x53600000;
mpu_firewall12.mpu_region[0].size             = 0x400;
mpu_firewall12.mpu_region[0].aidConfig        = ["M4FSS0_0"];
mpu_firewall12.mpu_region[0].permissionConfig = ["PER0","PER1","PER2","PER3","PER4","PER5","PER6","PER7"];
mpu_firewall12.mpu_region[0].allPermissions   = true;
mpu_firewall12.mpu_region[1].$name            = "CONFIG_MPU_FIREWALL_REGION31";
mpu_firewall12.mpu_region[1].startAddr        = 0x53600400;
mpu_firewall12.mpu_region[1].size             = 0xC9FFC00;
mpu_firewall12.mpu_region[1].allaidConfig     = true;
mpu_firewall12.mpu_region[1].allPermissions   = true;
mpu_firewall12.mpu_region[2].$name            = "CONFIG_MPU_FIREWALL_REGION13";
mpu_firewall12.mpu_region[2].size             = 0x3600000;
mpu_firewall12.mpu_region[2].allaidConfig     = true;
mpu_firewall12.mpu_region[2].allPermissions   = true;

mpu_firewall13.$name                        = "CONFIG_MPU_FIREWALL13";
mpu_firewall13.instance                     = "SCRM2SCRP1_SLV";
mpu_firewall13.mpu_region.create(3);
mpu_firewall13.mpu_region[0].$name          = "CONFIG_MPU_FIREWALL_REGION32";
mpu_firewall13.mpu_region[0].startAddr      = 0x53600000;
mpu_firewall13.mpu_region[0].size           = 0x400;
mpu_firewall13.mpu_region[0].aidConfig      = ["M4FSS0_0"];
mpu_firewall13.mpu_region[0].allPermissions = true;
mpu_firewall13.mpu_region[1].$name          = "CONFIG_MPU_FIREWALL_REGION33";
mpu_firewall13.mpu_region[1].startAddr      = 0x53600400;
mpu_firewall13.mpu_region[1].size           = 0xC9FFC00;
mpu_firewall13.mpu_region[1].allaidConfig   = true;
mpu_firewall13.mpu_region[1].allPermissions = true;
mpu_firewall13.mpu_region[2].$name          = "CONFIG_MPU_FIREWALL_REGION66";
mpu_firewall13.mpu_region[2].size           = 0x3600000;
mpu_firewall13.mpu_region[2].allaidConfig   = true;
mpu_firewall13.mpu_region[2].allPermissions = true;

mpu_firewall14.$name                        = "CONFIG_MPU_FIREWALL14";
mpu_firewall14.instance                     = "R5SS0_CORE0_AHB_MST";
mpu_firewall14.mpu_region.create(3);
mpu_firewall14.mpu_region[0].$name          = "CONFIG_MPU_FIREWALL_REGION34";
mpu_firewall14.mpu_region[0].startAddr      = 0x53600000;
mpu_firewall14.mpu_region[0].size           = 0x400;
mpu_firewall14.mpu_region[0].aidConfig      = ["M4FSS0_0"];
mpu_firewall14.mpu_region[0].allPermissions = true;
mpu_firewall14.mpu_region[1].$name          = "CONFIG_MPU_FIREWALL_REGION35";
mpu_firewall14.mpu_region[1].startAddr      = 0x53600400;
mpu_firewall14.mpu_region[1].size           = 0xC9FFC00;
mpu_firewall14.mpu_region[1].allaidConfig   = true;
mpu_firewall14.mpu_region[1].allPermissions = true;
mpu_firewall14.mpu_region[2].$name          = "CONFIG_MPU_FIREWALL_REGION12";
mpu_firewall14.mpu_region[2].size           = 0x3600000;
mpu_firewall14.mpu_region[2].allaidConfig   = true;
mpu_firewall14.mpu_region[2].allPermissions = true;

mpu_firewall15.$name                        = "CONFIG_MPU_FIREWALL15";
mpu_firewall15.instance                     = "R5SS0_CORE1_AHB_MST";
mpu_firewall15.mpu_region.create(3);
mpu_firewall15.mpu_region[0].$name          = "CONFIG_MPU_FIREWALL_REGION36";
mpu_firewall15.mpu_region[0].startAddr      = 0x53600000;
mpu_firewall15.mpu_region[0].size           = 0x400;
mpu_firewall15.mpu_region[0].aidConfig      = ["M4FSS0_0"];
mpu_firewall15.mpu_region[0].allPermissions = true;
mpu_firewall15.mpu_region[1].$name          = "CONFIG_MPU_FIREWALL_REGION37";
mpu_firewall15.mpu_region[1].startAddr      = 0x53600400;
mpu_firewall15.mpu_region[1].size           = 0xC9FFC00;
mpu_firewall15.mpu_region[1].allaidConfig   = true;
mpu_firewall15.mpu_region[1].allPermissions = true;
mpu_firewall15.mpu_region[2].$name          = "CONFIG_MPU_FIREWALL_REGION14";
mpu_firewall15.mpu_region[2].size           = 0x3600000;
mpu_firewall15.mpu_region[2].allaidConfig   = true;
mpu_firewall15.mpu_region[2].allPermissions = true;

mpu_firewall16.$name                        = "CONFIG_MPU_FIREWALL16";
mpu_firewall16.instance                     = "R5SS1_CORE0_AHB_MST";
mpu_firewall16.mpu_region.create(3);
mpu_firewall16.mpu_region[0].$name          = "CONFIG_MPU_FIREWALL_REGION38";
mpu_firewall16.mpu_region[0].allPermissions = true;
mpu_firewall16.mpu_region[0].startAddr      = 0x53600000;
mpu_firewall16.mpu_region[0].size           = 0x400;
mpu_firewall16.mpu_region[0].aidConfig      = ["M4FSS0_0"];
mpu_firewall16.mpu_region[1].$name          = "CONFIG_MPU_FIREWALL_REGION41";
mpu_firewall16.mpu_region[1].startAddr      = 0x53600400;
mpu_firewall16.mpu_region[1].size           = 0xC9FFC00;
mpu_firewall16.mpu_region[1].allaidConfig   = true;
mpu_firewall16.mpu_region[1].allPermissions = true;
mpu_firewall16.mpu_region[2].$name          = "CONFIG_MPU_FIREWALL_REGION15";
mpu_firewall16.mpu_region[2].size           = 0x3600000;
mpu_firewall16.mpu_region[2].allaidConfig   = true;
mpu_firewall16.mpu_region[2].allPermissions = true;

mpu_firewall17.$name                        = "CONFIG_MPU_FIREWALL17";
mpu_firewall17.instance                     = "R5SS1_CORE1_AHB_MST";
mpu_firewall17.mpu_region.create(3);
mpu_firewall17.mpu_region[0].$name          = "CONFIG_MPU_FIREWALL_REGION39";
mpu_firewall17.mpu_region[0].startAddr      = 0x53600000;
mpu_firewall17.mpu_region[0].size           = 0x400;
mpu_firewall17.mpu_region[0].aidConfig      = ["M4FSS0_0"];
mpu_firewall17.mpu_region[0].allPermissions = true;
mpu_firewall17.mpu_region[1].$name          = "CONFIG_MPU_FIREWALL_REGION40";
mpu_firewall17.mpu_region[1].startAddr      = 0x53600400;
mpu_firewall17.mpu_region[1].size           = 0xC9FFC00;
mpu_firewall17.mpu_region[1].allPermissions = true;
mpu_firewall17.mpu_region[1].allaidConfig   = true;
mpu_firewall17.mpu_region[2].$name          = "CONFIG_MPU_FIREWALL_REGION16";
mpu_firewall17.mpu_region[2].size           = 0x3600000;
mpu_firewall17.mpu_region[2].allaidConfig   = true;
mpu_firewall17.mpu_region[2].allPermissions = true;

mpu_firewall18.$name                        = "CONFIG_MPU_FIREWALL9";
mpu_firewall18.instance                     = "L2OCRAM_BANK4_SLV";
mpu_firewall18.mpu_region.create(1);
mpu_firewall18.mpu_region[0].$name          = "CONFIG_MPU_FIREWALL_REGION55";
mpu_firewall18.mpu_region[0].allaidConfig   = true;
mpu_firewall18.mpu_region[0].allPermissions = true;

mpu_firewall19.$name                        = "CONFIG_MPU_FIREWALL18";
mpu_firewall19.instance                     = "L2OCRAM_BANK5_SLV";
mpu_firewall19.mpu_region.create(1);
mpu_firewall19.mpu_region[0].$name          = "CONFIG_MPU_FIREWALL_REGION56";
mpu_firewall19.mpu_region[0].allaidConfig   = true;
mpu_firewall19.mpu_region[0].allPermissions = true;

mpu_firewall20.$name                        = "CONFIG_MPU_FIREWALL19";
mpu_firewall20.instance                     = "OSPI0_SLV";
mpu_firewall20.mpu_region.create(3);
mpu_firewall20.mpu_region[0].$name          = "CONFIG_MPU_FIREWALL_REGION57";
mpu_firewall20.mpu_region[0].allaidConfig   = true;
mpu_firewall20.mpu_region[0].allPermissions = true;
mpu_firewall20.mpu_region[1].$name          = "CONFIG_MPU_FIREWALL_REGION58";
mpu_firewall20.mpu_region[1].allaidConfig   = true;
mpu_firewall20.mpu_region[1].allPermissions = true;
mpu_firewall20.mpu_region[1].startAddr      = 0x80000000;
mpu_firewall20.mpu_region[2].$name          = "CONFIG_MPU_FIREWALL_REGION59";
mpu_firewall20.mpu_region[2].allaidConfig   = true;
mpu_firewall20.mpu_region[2].allPermissions = true;
mpu_firewall20.mpu_region[2].startAddr      = 0x88000000;

mpu_firewall21.$name                        = "CONFIG_MPU_FIREWALL20";
mpu_firewall21.instance                     = "OSPI0_CFG_SLV";
mpu_firewall21.mpu_region.create(1);
mpu_firewall21.mpu_region[0].$name          = "CONFIG_MPU_FIREWALL_REGION60";
mpu_firewall21.mpu_region[0].allaidConfig   = true;
mpu_firewall21.mpu_region[0].allPermissions = true;

mpu_firewall22.$name                        = "CONFIG_MPU_FIREWALL21";
mpu_firewall22.instance                     = "R5SS0_SLV";
mpu_firewall22.mpu_region.create(1);
mpu_firewall22.mpu_region[0].$name          = "CONFIG_MPU_FIREWALL_REGION63";
mpu_firewall22.mpu_region[0].allaidConfig   = true;
mpu_firewall22.mpu_region[0].allPermissions = true;

mpu_firewall23.$name                        = "CONFIG_MPU_FIREWALL22";
mpu_firewall23.instance                     = "R5SS1_SLV";
mpu_firewall23.mpu_region.create(1);
mpu_firewall23.mpu_region[0].$name          = "CONFIG_MPU_FIREWALL_REGION64";
mpu_firewall23.mpu_region[0].allaidConfig   = true;
mpu_firewall23.mpu_region[0].allPermissions = true;

clock.timerInputClkHz = 20000000;

debug_log.enableCssLog         = false;
debug_log.enableMemLog         = true;
debug_log.enableLogZoneError   = false;
debug_log.enableLogZoneWarning = false;

mpu_armv71.$name      = "CONFIG_MPU_REGION0";
mpu_armv71.size       = 31;
mpu_armv71.attributes = "Device";

mpu_armv72.$name      = "CONFIG_MPU_REGION1";
mpu_armv72.size       = 11;
mpu_armv72.baseAddr   = 0x44000000;
mpu_armv72.attributes = "Cached+Sharable";

mpu_armv73.$name      = "CONFIG_MPU_REGION2";
mpu_armv73.baseAddr   = 0xCE000000;
mpu_armv73.size       = 25;
mpu_armv73.attributes = "Device";

hsmserver1.$name = "CONFIG_HSMSERVER0";

keyring1.$name = "CONFIG_KEYRING0";
